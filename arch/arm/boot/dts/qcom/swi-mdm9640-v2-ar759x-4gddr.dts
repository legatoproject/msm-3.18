/* Copyright (c) 2015-2016, The Linux Foundation. All rights reserved.
 *
 * This program is free software; you can redistribute it and/or modify
 * it under the terms of the GNU General Public License version 2 and
 * only version 2 as published by the Free Software Foundation.
 *
 * This program is distributed in the hope that it will be useful,
 * but WITHOUT ANY WARRANTY; without even the implied warranty of
 * MERCHANTABILITY or FITNESS FOR A PARTICULAR PURPOSE.  See the
 * GNU General Public License for more details.
 */

/dts-v1/;

#include "swi-mdm9640-cust.dtsi"

/ {
	model = "Sierra Wireless, Inc. MSM 9640 V2 AR759x";
	compatible = "qcom,mdm9640-mtp", "qcom,mdm9640", "qcom,mtp";
	qcom,board-id = <8 0x101>;
};
