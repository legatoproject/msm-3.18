## drivers/iio/imu/bmi160/Kconfig
```kconfig
#
# Bosch BMI160 IMU drivers configuration
#

config SENSORS_BMI160_IIO
        tristate "BMI160 IMU IIO Driver"
        depends on I2C 
        select IIO_TRIGGERED_BUFFER if IIO_BUFFER
        help
	  If you say yes here you get support for Bosch Sensortec's
	  IMU drivers of BMI16x.

config ENABLE_ACC_GYRO_BUFFERING
	bool "Enable accel & gyro  boot time sensor sample buffering"
	depends on SENSORS_BMI160_IIO
	help
	 Say Y here if you want to buffer boot time sensor
         samples for BMI160 accelerometer and gyroscoper
```
